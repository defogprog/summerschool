# file: text_to_morse_blink.ioc
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Mcu.Family=STM32F4
Mcu.Name=STM32F401C(B-C)Ux
Mcu.Package=UFQFPN48
NVIC.PriorityGroup=NVIC_PRIORITYGROUP_4
PC13-ANTI_TAMP.PinState=GPIO_PIN_SET
PC13-ANTI_TAMP.Signal=GPIO_Output
ProjectManager.HeapSize=0x200
ProjectManager.StackSize=0x400
ProjectManager.TargetToolchain=STM32CubeIDE
RCC.AHBFreq_Value=16000000
RCC.APB1Freq_Value=16000000
RCC.APB2Freq_Value=16000000
RCC.CortexFreq_Value=16000000
RCC.HSE_VALUE=25000000
RCC.HSI_VALUE=16000000
RCC.LSE_VALUE=32768
RCC.SYSCLKFreq_VALUE=16000000
RCC.VCOOutputFreq_Value=192000000
board=custom

// file: Core/Src/main.c
/* USER CODE BEGIN Header */
/**
  ******************************************************************************
  * @file           : main.c
  * @brief          : Main program body
  ******************************************************************************
  * @attention
  *
  * Copyright (c) 2022 STMicroelectronics.
  * All rights reserved.
  *
  * This software is licensed under terms that can be found in the LICENSE file
  * in the root directory of this software component.
  * If no LICENSE file comes with this software, it is provided AS-IS.
  *
  ******************************************************************************
  */
/* USER CODE END Header */
#include "main.h"

void SystemClock_Config(void);
static void MX_GPIO_Init(void);
/* USER CODE BEGIN PFP */
uint8_t strToMorseBlink(char *str);
/* USER CODE END PFP */

int main(void)
{

  /* MCU Configuration--------------------------------------------------------*/

  /* Reset of all peripherals, Initializes the Flash interface and the Systick. */
  HAL_Init();

  /* Configure the system clock */
  SystemClock_Config();

  /* Initialize all configured peripherals */
  MX_GPIO_Init();

  /* Infinite loop */
  /* USER CODE BEGIN WHILE */
  while (1)
  {
	  HAL_Delay(1000);
	  if(strToMorseBlink("HELLO, WORLD!"))
		  while(1)
		  {
			  HAL_GPIO_TogglePin(GPIOC, GPIO_PIN_13);
			  HAL_Delay(50);
		  }
	  HAL_Delay(5000);
    /* USER CODE END WHILE */

  }
}

void SystemClock_Config(void)
{
  RCC_OscInitTypeDef RCC_OscInitStruct = {0};
  RCC_ClkInitTypeDef RCC_ClkInitStruct = {0};

  /** Configure the main internal regulator output voltage
  */
  __HAL_RCC_PWR_CLK_ENABLE();
  __HAL_PWR_VOLTAGESCALING_CONFIG(PWR_REGULATOR_VOLTAGE_SCALE2);

  /** Initializes the RCC Oscillators according to the specified parameters
  * in the RCC_OscInitTypeDef structure.
  */
  RCC_OscInitStruct.OscillatorType = RCC_OSCILLATORTYPE_HSI;
  RCC_OscInitStruct.HSIState = RCC_HSI_ON;
  RCC_OscInitStruct.HSICalibrationValue = RCC_HSICALIBRATION_DEFAULT;
  RCC_OscInitStruct.PLL.PLLState = RCC_PLL_NONE;
  if (HAL_RCC_OscConfig(&RCC_OscInitStruct) != HAL_OK)
  {
    Error_Handler();
  }

  /** Initializes the CPU, AHB and APB buses clocks
  */
  RCC_ClkInitStruct.ClockType = RCC_CLOCKTYPE_HCLK|RCC_CLOCKTYPE_SYSCLK
                              |RCC_CLOCKTYPE_PCLK1|RCC_CLOCKTYPE_PCLK2;
  RCC_ClkInitStruct.SYSCLKSource = RCC_SYSCLKSOURCE_HSI;
  RCC_ClkInitStruct.AHBCLKDivider = RCC_SYSCLK_DIV1;
  RCC_ClkInitStruct.APB1CLKDivider = RCC_HCLK_DIV1;
  RCC_ClkInitStruct.APB2CLKDivider = RCC_HCLK_DIV1;

  if (HAL_RCC_ClockConfig(&RCC_ClkInitStruct, FLASH_LATENCY_0) != HAL_OK)
  {
    Error_Handler();
  }
}

static void MX_GPIO_Init(void)
{
  GPIO_InitTypeDef GPIO_InitStruct = {0};

  /* GPIO Ports Clock Enable */
  __HAL_RCC_GPIOC_CLK_ENABLE();

  /*Configure GPIO pin Output Level */
  HAL_GPIO_WritePin(GPIOC, GPIO_PIN_13, GPIO_PIN_SET);

  /*Configure GPIO pin : PC13 */
  GPIO_InitStruct.Pin = GPIO_PIN_13;
  GPIO_InitStruct.Mode = GPIO_MODE_OUTPUT_PP;
  GPIO_InitStruct.Pull = GPIO_NOPULL;
  GPIO_InitStruct.Speed = GPIO_SPEED_FREQ_LOW;
  HAL_GPIO_Init(GPIOC, &GPIO_InitStruct);

}

/* USER CODE BEGIN 4 */
uint8_t strToMorseBlink(char *str)
{
    /* SORTED ASCII CHAR SET */
    const char ascii[54] = {'!', '"', '$', '&', '\'', '(', ')', '+', ',', '-', '.', '/', '0', '1', '2',
                            '3', '4', '5', '6', '7',  '8', '9', ':', ';', '=', '?', '@', 'A', 'B', 'C',
                            'D', 'E', 'F', 'G', 'H',  'I', 'J', 'K', 'L', 'M', 'N', 'O', 'P', 'Q', 'R',
                            'S', 'T', 'U', 'V', 'W',  'X', 'Y', 'Z', '_'};

  /* A SET OF VALUES GENERATED ACCORDING TO ASCII CHAR SET
   * EXAMPLE:
   * BYTE PTR ascii[27]      	= 'L'     ELEMENT OF AN ASCII CHAR SET
   * BYTE PTR morse[27 * 2]     = 0100b   'L' MORSE CODE IN BINARY (.-..)
   * BYTE PTR morse[27 * 2 + 1] = 4   	  MORSE CODE LENGTH */
    const unsigned short morse[54] = {  11014, 4614, 2311, 2053, 7686, 5637, 11526, 2565, 13062, 8454, 5382, 4613, 7941, 3845, 1797,
    									773,   261,  5,    4101, 6149, 7173, 7685,  14342,10758, 4357, 3078, 6662, 258,  2052, 2564,
										1027,  1,    516,  1539, 4,    2,    1796,  1283, 1028,  770,  514,  1795, 1540, 3332, 515,
										3,     257,  259,  260,  771,  2308, 2820,  3076, 3334  };

    int8_t j, L, R;                               // BINARY SEARCH VARIABLES
    uint16_t dot = 200, dash = 3 * dot;      	   // DOT AND DASH DISPLAY TIME
    for (uint32_t i = 0; str[i] != '\0'; i++)
    {
        j = -1, L = 0, R = 53;
        while (L <= R)
            if (str[i] == ascii[(R - L) / 2 + L]){
                j = (R - L) / 2 + L;
                break;
            }
            else if (str[i] < ascii[(R - L) / 2 + L])
                R = (R - L) / 2 + L - 1;
            else
                L = (R - L) / 2 + L + 1;

        if(j != -1)
        {
          for (short k = (morse[j] & 0xFF) + 7; k >= 8; k--)
            {
                HAL_GPIO_WritePin(GPIOC, GPIO_PIN_13, GPIO_PIN_RESET);
                HAL_Delay(((morse[j] >> k) & 1) ? dash : dot);
                HAL_GPIO_WritePin(GPIOC, GPIO_PIN_13, GPIO_PIN_SET);
                HAL_Delay(dot);
            }
          HAL_Delay(2 * dot);
        }
        else if(str[i] == ' ')
          HAL_Delay(2 * dash);
        else
          return 1;
    }
    return 0;
}
/* USER CODE END 4 */

void Error_Handler(void)
{
  __disable_irq();
  while (1)
  {
  }
}
